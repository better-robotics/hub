## esp32/sdkconfig.defaults
```kconfig
# mosq_broker_run() blocks in the main task and Mosquitto wants >=5KB stack.
CONFIG_ESP_MAIN_TASK_STACK_SIZE=10240

# NAT: forward AP-side traffic out the STA uplink (esp32_nat_router equivalent,
# built into ESP-IDF lwIP). Without these, joining the AP is a dead-end island.
CONFIG_LWIP_IP_FORWARD=y
CONFIG_LWIP_IPV4_NAPT=y

# WebSocket server support for the WS<->TCP bridge (browser MQTT-over-WS).
CONFIG_HTTPD_WS_SUPPORT=y

# Each browser bridge uses 2 sockets (WS + broker TCP) on top of the broker's
# own; default 10 is too tight once a few clients + the httpd listener stack up.
CONFIG_LWIP_MAX_SOCKETS=16

# Board has 4MB flash; the default 1MB app partition can't hold the firmware +
# the embedded 388KB dashboard. Use the large single-app layout (~1.9MB app).
CONFIG_ESPTOOLPY_FLASHSIZE_4MB=y
CONFIG_PARTITION_TABLE_SINGLE_APP_LARGE=y
```
